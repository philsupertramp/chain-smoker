## smoke_tests/sample.yaml
```yaml
type: 'api-test'

config:
  client:
    base_url: 'https://api.dev.moberries.com/api/v2/'
    auth_header:
      Authorization: "JWT eyJ0eXAiOiJKV1QiLCJhbGciOiJIUzI1NiJ9.eyJ1c2VyX2lkIjoxMDAwMDAyLCJlbWFpbCI6InN1cGVyX3VzZXJAbW9iZXJyaWVzLmNvbSIsInVzZXJuYW1lIjoxMDAwMDAyLCJleHAiOjE2NjM1ODY2MjYsImlkIjoxMDAwMDAyLCJvcmlnX2lhdCI6MTY2MDk5NDYyNn0.UB8Sz7qELEc6LZLLVf8n8cmAhkPmssMS-mRg3f8Q3j8"

tests:
  job_roles:
    endpoint: 'jobroles/3'
    method: 'get'
    expected: "{'id': 3, 'name': 'Product Sales Manager', 'categories': [{'name': 'Sales', 'id': 4}], 'is_visible': True}"
  countries:
    endpoint: 'countries/8505078/'
    method: 'get'
    expected: "{\"name\": \"Greenland\", \"id\": 8505078, \"place_id\": \"ChIJFXfA47sNok4RGOIUAYOdzzQ\", \"code\": \"GL\",\"region\": null}"
  cities:
    endpoint: 'cities/11245730/'
    method: 'get'
    expected: "{\"name\":\"Südwestpfalz\",\"id\":11245730,\"place_id\":\"ChIJa1C9KYV7lkcRfMDaNZ3Mz30\",\"country\":{\"name\":\"Germany\",\"id\":2921044,\"place_id\":\"ChIJa76xwh5ymkcRW-WRjmtd6HU\",\"code\":\"DE\",\"region\":\"western_europe\"},\"jobs_count\":0,\"location\":{\"latitude\":49.2309251,\"longitude\":7.5487474}}"
```

## tests/chain_smoker/fixtures/sample.yaml
```yaml
type: 'api-test'
config:
  client:
    base_url: 'https://example.com'
tests:
  test_something:
    method: 'get'
    status_code: 200
    contains:
      This domain is for use in illustrative examples in documents. You may use this domain in literature without prior
      coordination or asking for permission.
  test_same_request_twice:
    multi_step: true
    steps:
      - name: 'first_request'
        method: 'get'
        status_code: 200
      - name: 'second_request'
        method: 'get'
        status_code: 200
```
